## libs/libqmi/Config.in
```kconfig
menu "Configuration"
	depends on PACKAGE_libqmi

config LIBQMI_WITH_MBIM_QMUX
	bool "Include MBIM QMUX service support"
	default y
	help
	  Compile libqmi with QMI-over-MBIM support

config LIBQMI_WITH_QRTR_GLIB
	bool "Include QRTR support"
	depends on !(LINUX_2_6_36||LINUX_3_2||LINUX_3_4||LINUX_3_10)
	default y
	help
	  Compile libqmi with QRTR support (Linux >= 4.7.0)

choice
	prompt "Select QMI message collection to build"
	default LIBQMI_COLLECTION_BASIC

	config LIBQMI_COLLECTION_MINIMAL
		depends on !MODEMMANAGER_WITH_QMI
		bool "minimal"

	config LIBQMI_COLLECTION_BASIC
		bool "basic (default)"

	config LIBQMI_COLLECTION_FULL
		bool "full"
endchoice

endmenu
```
